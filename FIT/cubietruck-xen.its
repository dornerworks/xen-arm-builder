## FIT/cubietruck-xen.its
```
/*
 * U-boot uImage source file with multiple kernels, ramdisks and FDT blobs
 *
 * Modified from it's template to load a Xen Kernel
 */

/dts-v1/;

/ {
    description = "Configuration to load a Xen Kernel";
    #address-cells = <1>;

    images {
        xen_kernel@1 {
            description = "xen-4.6.0-unstable";
            data = /incbin/("./xen");
            type = "kernel";
            arch = "arm";
            os = "linux";
            compression = "none";
            load = <0xaea00000>;
            entry = <0xaea00000>;
            hash@1 {
                algo = "md5";
            };
        };

        fdt@1 {
            description = "Cubietruck Xen tree blob";
            data = /incbin/("./xen.dtb");
            type = "flat_dt";
            arch = "arm";
            compression = "none";
            load = <0xaec00000>;
            hash@1 {
                algo = "md5";
            };
        };

        fdt@2 {
            description = "Cubietruck Linux tree blob";
            data = /incbin/("./sun7i-a20-cubietruck.dtb");
            type = "flat_dt";
            arch = "arm";
            compression = "none";
            load = <0xaec00000>;
            hash@1 {
                algo = "md5";
            };
        };

        linux_kernel@1 {
            description = "Linux zImage";
            data = /incbin/("./vmlinuz");
            type = "kernel";
            arch = "arm";
            os = "linux";
            compression = "none";
            load = <0xaf600000>;
            entry = <0xaf600000>;
            hash@1 {
                algo = "md5";
            };
        };
    };

    configurations {
        default = "config@2";

        config@1 {
            description = "Just plain Linux";
            kernel = "linux_kernel@1";
            fdt = "fdt@2";
        };

        config@2 {
            description = "Xen 4.6.0-one loadable";
            kernel = "xen_kernel@1";
            fdt = "fdt@1";
            loadables = "linux_kernel@1";
        };
    };
};
```
